## Kconfig
```kconfig
#
# Copyright 2017, DornerWorks
#
# This software may be distributed and modified according to the terms of
# the GNU General Public License version 2. Note that NO WARRANTY is provided.
# See "LICENSE_GPLv2.txt" for details.
#
# @TAG(DORNERWORKS_GPL)
#
# This data was produced by DornerWorks, Ltd. of Grand Rapids, MI, USA under
# a DARPA SBIR, Contract Number D16PC00107.
#
# Approved for Public Release, Distribution Unlimited.
#

menuconfig APP_GDB_TEST
bool "GDB test application"
default n
    help
        GDB test

config GDB_PRINT_DEBUG
bool "Print the sent and received GDB Packets. Warning, may effect GDB timing and performance"
depends on APP_GDB_TEST
default n
    help
        debug printing
```
